
/ {
    // キーマトリクス行の定義（GPIOポートとピン番号を指定）
    row-gpios = <&gpio0 10 GPIO_ACTIVE_HIGH>,
                <&gpio0 11 GPIO_ACTIVE_HIGH>,
                <&gpio0 12 GPIO_ACTIVE_HIGH>;

    // キーマトリクス列の定義
    col-gpios = <&gpio1 3 GPIO_ACTIVE_HIGH>,
                <&gpio1 4 GPIO_ACTIVE_HIGH>,
                <&gpio1 5 GPIO_ACTIVE_HIGH>,
                <&gpio1 6 GPIO_ACTIVE_HIGH>;

    // ダイオードの方向
    diode-direction = "col2row";
};
