## config/west.yml
```yaml
manifest:
  remotes:
    - name: zmkfirmware
      url-base: https://github.com/zmkfirmware
  projects:
    - name: zmk
      remote: zmkfirmware
      revision: main  # 安定版を使う場合はタグ(例: v3.2)を指定
      path: firmware/zmk
  self:
    path: config
```
