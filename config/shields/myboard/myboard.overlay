/ {
    // Row GPIO pins
    row-gpios = <&gpio0 10 GPIO_ACTIVE_HIGH>,
                <&gpio0 11 GPIO_ACTIVE_HIGH>,
                <&gpio0 12 GPIO_ACTIVE_HIGH>,
                <&gpio0 13 GPIO_ACTIVE_HIGH>,
                <&gpio0 14 GPIO_ACTIVE_HIGH>,
                <&gpio0 15 GPIO_ACTIVE_HIGH>;

    // Col GPIO pins
    col-gpios = <&gpio0 17 GPIO_ACTIVE_HIGH>,
                <&gpio0 18 GPIO_ACTIVE_HIGH>,
                <&gpio0 19 GPIO_ACTIVE_HIGH>,
                <&gpio0 20 GPIO_ACTIVE_HIGH>,
                <&gpio0 21 GPIO_ACTIVE_HIGH>,
                <&gpio0 22 GPIO_ACTIVE_HIGH>,
                <&gpio0 23 GPIO_ACTIVE_HIGH>;

    diode-direction = "col2row";
};
